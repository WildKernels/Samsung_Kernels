## kernel_platform/common/arch/arm64/configs/gki_sec_defconfig
```kconfig
# Samsung defconfig for GKI build
# SEC_PRODUCT_FEATURE_KNOX_SUPPORT_NPA
# CONFIG_KNOX_NCM is not set

# KNOX-DDAR
# CONFIG_DDAR is not set

# [ SEC_SELINUX_PORTING_COMMON
CONFIG_EXT4_FS_SECURITY=y
CONFIG_AUDIT=y
CONFIG_LSM_MMAP_MIN_ADDR=4096
CONFIG_SECURITY_SELINUX=y
CONFIG_DEFAULT_SECURITY_SELINUX=y
CONFIG_NETFILTER_ADVANCED=y
CONFIG_NETFILTER_XT_TARGET_LOG=y
CONFIG_SECURITY_SELINUX_DEVELOP=y
CONFIG_AUDITSYSCALL=y
CONFIG_PROC_AVC=y
# ] SEC_SELINUX_PORTING_COMMON

# FIPS
CONFIG_CRYPTO_SKC_FIPS=y



# CONFIG_UH is not set
# CONFIG_UH_RKP is not set
# CONFIG_UH_LKMAUTH is not set
# CONFIG_UH_LKM_BLOCK is not set



# CONFIG_RKP is not set
# CONFIG_RKP_CFP_JOPP is not set
# CONFIG_RKP_CFP is not set



# CONFIG_KDP is not set



# CONFIG_FIVE is not set




# CONFIG_PROCA is not set




# CONFIG_PROCA_S_OS is not set




# CONFIG_FIVE_TEE_DRIVER is not set




# CONFIG_FIVE_PA_FEATURE is not set




#CONFIG_FIVE_GKI_10 is not set




#CONFIG_PROCA_GKI_10 is not set




CONFIG_GAF=y




CONFIG_GAF_V6=y












































































# CONFIG_SECURITY_DEFEX is not set




# CONFIG_SECURITY_DEFEX_USER is not set




# CONFIG_SECURITY_DEFEX_DTM is not set




# CONFIG_SECURITY_DEFEX_IMR is not set




CONFIG_SMB_SERVER=y




CONFIG_SMB_SERVER_CHECK_CAP_NET_ADMIN=y




CONFIG_SECURITY_DSMS=y




CONFIG_SECURITY_KUMIHO=y




CONFIG_NTFS3_FS=y












CONFIG_NTFS3_LZX_XPRESS=y












CONFIG_NLS=y












CONFIG_EROFS_FS=y












CONFIG_F2FS_FS=y












CONFIG_F2FS_FS_SECURITY=y












CONFIG_F2FS_FS_COMPRESSION=y












CONFIG_EXT4_FS_POSIX_ACL=y
```

## kernel_platform/msm-kernel/drivers/sensors_lego/Kconfig
```kconfig
#
# grip sensors configuration
#

config SENSORS_SX9360
	depends on I2C
	tristate "SX9360 driver"
	default n
	help
	  Say Y here if you use sx9360.
	  This option enables grip sensors using
	  SemTech sx9360 device driver.
	  Say N here if you do not use sx9360.

config SENSORS_SX9360_SUB
	depends on I2C
	tristate "SX9360 sub driver"
	default n
	help
	  Say Y here if you use sx9360 sub.
	  This option enables grip sensors using
	  SemTech sx9360 sub device driver.
	  Say N here if you do not use sx9360 sub.

config SENSORS_SX9364
	depends on I2C
	tristate "SX9364 driver"
	default n
	help
	  Say Y here if you use sx9364.
	  This option enables grip sensors using
	  SemTech sx9360 device driver.
	  Say N here if you do not use sx9364.

config SENSORS_SX9364_SUB
	depends on I2C
	tristate "SX9364_SUB driver"
	default n
	help
	  Say Y here if you use sx9364_sub.
	  This option enables grip sensors using
	  SemTech sx9364_sub device driver.
	  Say N here if you do not use sx9364_sub.


config SENSORS_DUMP_DATA
	tristate "Grip sensor dump log"
	default n
	help
	  Enable grip dump log data
	  This option activates log output of grip error data using sensordump_notifier.

config SENSORS_GRIP_FAILURE_DEBUG
	bool "Grip failure debug"
	help
	  Say Y here, Enable Grip failure debug flag.

config SENSORS_IRQ_PROCESSING_DELAY
	depends on I2C
	tristate "Grip IRQ processing delay"
	default n
	help
	  Say Y here, Make irq thread is called after resume.

config SENSORS_CHECK_PMIC_DEPENDENCY
	bool "SX9360 check pmic dependency"
	default n
	help
	  Enable check pmic dependency
	  This option enables check pmic dependency.

config SENSORS_FOLDABLE_SMD
	bool "SX9385 foldable smd"
	default n
	help
	  Enable foldable smd mode
	  This option enables foldable smd mode.
```
