/dts-v1/;
/plugin/;

#include "scuba-iot-idp-lp4.dtsi"

/ {
	model = "Qualcomm Technologies, Inc. Scuba IOT LP4 IDP";
	compatible = "qcom,scuba-idp", "qcom,scuba-iot", "qcom,idp";
	qcom,msm-id =  <441 0x10000>,<473 0x10000>, <474 0x10000>;
	qcom,board-id = <34 6>;
};
