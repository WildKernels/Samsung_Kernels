## kernel_platform/msm-kernel/drivers/input/sec_input/stm_fst2ba61c_spi/Kconfig
```kconfig
# SPDX-License-Identifier: GPL-2.0-only
#
# STM TOUCH driver configuration
#

config TOUCHSCREEN_STM_FST2BA61C_I2C
	tristate "STM Touchscreen"
	depends on I2C
    help
      Say Y here if you want support for STM touchscreen controllers.
      If unsure, say N.

config TOUCHSCREEN_STM_FST2BA61C_SPI
    tristate "STM SPI Touchscreen"
    depends on SPI
    help
      Say Y here if you want support for STM SPI touchscreen controllers.
      If unsure, say N.
```

## vendor/qcom/opensource/display-drivers/sec_display_defconfig
```kconfig
CONFIG_SECDP=y # nocheck: It is intended for displayport, ignore it.
CONFIG_SECDP_LOGGER=y # nocheck: It is intended for displayport, ignore it.
CONFIG_SECDP_BIGDATA=y # nocheck: It is intended for displayport, ignore it.
CONFIG_SECDP_SWITCH=y # nocheck: It is intended for displayport, ignore it.
CONFIG_SECDP_DBG=y # nocheck: It is intended for displayport, ignore it.
CONFIG_SECDP_FACTORY_DPSWITCH_TEST=y # nocheck: It is intended for displayport, ignore it.

CONFIG_PANEL_PA1_S6E3FAE_AMB616FL03_FHD=y
CONFIG_PANEL_PA1_S6E3FAE_AMB616FL03_VHM_FHD=y
CONFIG_DISPLAY_SAMSUNG=y
CONFIG_LCD_CLASS_DEVICE=y
```
