&smd {
	max77705_fuelgauge: max77705-fuelgauge {
			    /* for 4500mAh battery */
			    status = "okay";
			    fuelgauge,fuel_alert_soc = <1>;
			    fuelgauge,jig_gpio = <SEC_GPIO_REF(AP,tlmm,176) 0>; /* IFC_SENSE_INT_AP */
			    fuelgauge,jig_low_active;
			    fuelgauge,capacity_max = <1000>;
			    fuelgauge,capacity_max_margin = <300>;
			    fuelgauge,capacity_min = <0>;
			    fuelgauge,capacity_calculation_type = <28>;
			    fuelgauge,repeated_fuelalert;
			    fuelgauge,using_temp_compensation;
			    fuelgauge,low_temp_limit = <100>;
			    fuelgauge,vempty_recover_time = <180>; /* 3 mins */
			    fuelgauge,using_hw_vempty;
			    fuelgauge,sw_v_empty_voltage = <3200>;
			    fuelgauge,sw_v_empty_voltage_cisd = <3100>;
			    fuelgauge,sw_v_empty_recover_voltage = <3480>;
			    fuelgauge,fg_resistor = <2>;
#if 1
			    fuelgauge,bat_id_gpio = <
#if 1
					SEC_GPIO_REF(AP,tlmm,97) 0 /* BAT_ID_GPIO 1 */
#endif
					SEC_GPIO_REF(AP,tlmm,10) 0 /* BAT_ID_GPIO 0 */
					>;
#endif
#if 0
			    fuelgauge,sub_bat_id_gpio = <
#if 0
					SEC_GPIO_REF(${sub_bat_id_gpio_2}) 0 /* SUB_BAT_ID_GPIO 1 */
#endif
					SEC_GPIO_REF(${sub_bat_id_gpio}) 0 /* SUB_BAT_ID_GPIO 0 */
					>;
#endif
			    battery_params {
				/* battery0 : default */
				battery0,v_empty = <0xA7E2>; /* Empty: 3350mV, Recover: 3920mV */
				battery0,v_empty_origin = <0x7D54>; /* Empty: 2500mV, Recover: 3360mV */
				battery0,capacity = <0x0FEF>;
				/* fullcapnom(=capacity), dPacc, dQacc,  rcomp0, tempco */
				battery0,fg_reset_wa_data = <0x0FEF 0x3200 0x03FB 0x003A 0x2534>;

				/* battery1 */
				battery1,v_empty = <0xA7E2>; /* Empty: 3350mV, Recover: 3920mV */
				battery1,v_empty_origin = <0x7D54>; /* Empty: 2500mV, Recover: 3360mV */
				battery1,capacity = <0x0FFF>;
				/* fullcapnom(=capacity), dPacc, dQacc,  rcomp0, tempco */
				battery1,fg_reset_wa_data = <0x0FFF 0x3200 0x03FB 0x003A 0x2534>;
			    };
		    };
};

/* /home/dpi/qb5_8814/workspace/P4_1716/android/kernel_platform/kmodule/battery/stable/dm/fuelgauge/max77705/dm2q/max77705_fuelgauge.dtsi */
&max77705_fuelgauge {
	fuelgauge,capacity_calculation_type = <0x5C>;
	fuelgauge,lost_soc_trig_soc = <1000>; /* 100.0% */
	fuelgauge,lost_soc_trig_d_soc = <20>; /* 2% */
	fuelgauge,lost_soc_trig_scale = <2>; /* 2x */
	fuelgauge,lost_soc_guarantee_soc = <30>; /* 3.0% */
	fuelgauge,lost_soc_min_vol = <3200>; /* 3200mV */
	fuelgauge,fg_resistor = <5>; /* 2 milliohm */
	fuelgauge,scale_to_102;

	battery_params {
		/*
		 * BAT_ID_1/BAT_ID_2
		 * 11: SDI, 10: ATL
		 * 01: TBD, 00: TBD
		 */

		/* 00 : battery data */
		battery0,v_empty = <0xA561>; /* Empty: 3400mV, Recover: 4000mV */
		battery0,v_empty_origin = <0x7D54>; /* Empty: 2500mV, Recover: 3360mV */
		battery0,capacity = <0x0708>;
					/* fullcapnom dPacc dQacc RCOMP0 TempCo */
		battery0,fg_reset_wa_data = <0x0708 0x3200 0x01C2 0x002F 0x171F>;

		battery0,data_ver = <0x4>;

			battery0,atRate = <0x1900>; //2100mA
			battery0,config = <0x0210>; //0x0110 (FGCC disabled & Thermistor disable)
			battery0,config2 = <0x0050>; //TAlrtEn as 1 & OCVQen enable
			battery0,convgCfg = <0x2440>;
			battery0,fullcaprep = <0x0708>;
			battery0,fullsocthr = <0x5F00>;//95%
			battery0,iavg_empty = <0x05A0>;
			battery0,learnCFG = <0x2606>;
			battery0,misccfg = <0x3850>; //0x0870 (MixRate as 1.875000 mA)
			battery0,cv_mixCap = <0x1356>; //CV_MixCap (2475mA) is 75% of FullCapNom (0x17FA ; 3300mAh)
			battery0,cv_HalfTime = <0x0600>; //18 minutes --> 30*60/(0.1758125*4) = 1536 = 0x0600
			battery0,tempNom = <0x1403>;
			battery0,tempLim = <0x1E05>;

			/* Address 0x80h starts here */
			battery0,cell_character0 = <
				0xa780 0xb360 0xb890 0xbac0 0xbc90 0xbcf0 0xbd80 0xbe30
				0xbf80 0xc040 0xc240 0xc2b0 0xc9b0 0xce60 0xd500 0xdaf0
			>;
			/* Address 0x90h starts here */
			battery0,cell_character1 = <
				0x0100 0x0600 0x1100 0x0cf0 0x2a10 0x1a40 0x1700 0x0f00
				0x1ab0 0x0cf0 0x0c80 0x07d0 0x07f0 0x06d0 0x06f0 0x06f0
			>;
			/* Address 0xA0h starts here */
			battery0,cell_character2 = <
				0x0200 0x0200 0x0200 0x0200 0x0200 0x0200 0x0200 0x0200
				0x0200 0x0200 0x0200 0x0200 0x0200 0x0200 0x0200 0x0200
			>;

		battery0,selected_reg = <
			0x02 0x7F80	/* default */
			0x12 0x3C00	/* QResidual00 */
			0x1E 0x0247	/* ICHGTerm */
			0x21 0x6200	/* default */
			0x22 0x1E00	/* QResidual10 */
			0x2A 0x023C	/* RelaxCFG */
			0x2C 0xE3E1	/* TGAIN */
			0x2D 0x290E	/* TOFF */
			0x2E 0x0400	/* CGAIN */
			0x2F 0x0001	/* COFF */
			0x32 0x0F00	/* QResidual20 */
			0x33 0xFFFF	/* default */
			0x37 0x05E0	/* default */
			0x42 0x0D00	/* QResidual30 */
			0xB4 0x7F80	/* default */
			0xB8 0x0000	/* default */
			0xB9 0x006B	/* default */
			0xBA 0x090C	/* default */
			>;

		/* 01 : battery data */
		battery1,v_empty = <0xA561>; /* Empty: 3400mV, Recover: 4000mV */
		battery1,v_empty_origin = <0x7D54>; /* Empty: 2500mV, Recover: 3360mV */
		battery1,capacity = <0x0708>;
					/* fullcapnom dPacc dQacc RCOMP0 TempCo */
		battery1,fg_reset_wa_data = <0x0708 0x3200 0x01C2 0x002F 0x171F>;

		battery1,data_ver = <0x4>;

			battery1,atRate = <0x1900>; //2100mA
			battery1,config = <0x0210>; //0x0110 (FGCC disabled & Thermistor disable)
			battery1,config2 = <0x0050>; //TAlrtEn as 1 & OCVQen enable
			battery1,convgCfg = <0x2440>;
			battery1,fullcaprep = <0x0708>;
			battery1,fullsocthr = <0x5F00>; //95%
			battery1,iavg_empty = <0x05A0>;
			battery1,learnCFG = <0x2606>;
			battery1,misccfg = <0x3850>; //0x0870 (MixRate as 1.875000 mA)
			battery1,cv_mixCap = <0x1356>; //CV_MixCap (2475mA) is 75% of FullCapNom (0x17FA ; 3300mAh)
			battery1,cv_HalfTime = <0x0600>; //18 minutes --> 30*60/(0.1758125*4) = 1536 = 0x0600
			battery1,tempNom = <0x1403>;
			battery1,tempLim = <0x1E05>;

			/* Address 0x80h starts here */
			battery1,cell_character0 = <
				0xa780 0xb360 0xb890 0xbac0 0xbc90 0xbcf0 0xbd80 0xbe30
				0xbf80 0xc040 0xc240 0xc2b0 0xc9b0 0xce60 0xd500 0xdaf0
			>;
			/* Address 0x90h starts here */
			battery1,cell_character1 = <
				0x0100 0x0600 0x1100 0x0cf0 0x2a10 0x1a40 0x1700 0x0f00
				0x1ab0 0x0cf0 0x0c80 0x07d0 0x07f0 0x06d0 0x06f0 0x06f0
			>;
			/* Address 0xA0h starts here */
			battery1,cell_character2 = <
				0x0200 0x0200 0x0200 0x0200 0x0200 0x0200 0x0200 0x0200
				0x0200 0x0200 0x0200 0x0200 0x0200 0x0200 0x0200 0x0200
			>;

		battery1,selected_reg = <
			0x02 0x7F80	/* default */
			0x12 0x3C00	/* QResidual00 */
			0x1E 0x0247	/* ICHGTerm */
			0x21 0x6200	/* default */
			0x22 0x1E00	/* QResidual10 */
			0x2A 0x023C	/* RelaxCFG */
			0x2C 0xE3E1	/* TGAIN */
			0x2D 0x290E	/* TOFF */
			0x2E 0x0400	/* CGAIN */
			0x2F 0x0001	/* COFF */
			0x32 0x0F00	/* QResidual20 */
			0x33 0xFFFF	/* default */
			0x37 0x05E0	/* default */
			0x42 0x0D00	/* QResidual30 */
			0xB4 0x7F80	/* default */
			0xB8 0x0000	/* default */
			0xB9 0x006B	/* default */
			0xBA 0x090C	/* default */
			>;

		/* 10 : battery data */
		battery2,v_empty = <0xA561>; /* Empty: 3400mV, Recover: 4000mV */
		battery2,v_empty_origin = <0x7D54>; /* Empty: 2500mV, Recover: 3360mV */
		battery2,capacity = <0x06D6>;
					/* fullcapnom dPacc dQacc RCOMP0 TempCo */
		battery2,fg_reset_wa_data = <0x06D6 0x3200 0x01B5 0x0029 0x151E>;

		battery2,data_ver = <0x6>;

			battery2,atRate = <0x1900>; //2100mA
			battery2,config = <0x0210>; //0x0110 (FGCC disabled & Thermistor disable)
			battery2,config2 = <0x0050>; //TAlrtEn as 1 & OCVQen enable
			battery2,convgCfg = <0x2440>;
			battery2,fullcaprep = <0x06D6>;
			battery2,fullsocthr = <0x5F00>; //95%
			battery2,iavg_empty = <0x0578>;
			battery2,learnCFG = <0x2606>;
			battery2,misccfg = <0x3870>; //0x0870 (MixRate as 1.875000 mA)
			battery2,cv_mixCap = <0x1356>; //CV_MixCap (2475mA) is 75% of FullCapNom (0x17FA ; 3300mAh)
			battery2,cv_HalfTime = <0x0600>; //18 minutes --> 30*60/(0.1758125*4) = 1536 = 0x0600
			battery2,tempNom = <0x1403>;
			battery2,tempLim = <0x1E05>;

			/* Address 0x80h starts here */
			battery2,cell_character0 = <
				0xa6a0 0xb790 0xb8e0 0xba30 0xbb80 0xbd00 0xbe40 0xbf20
				0xc1d0 0xc510 0xc780 0xcbc0 0xcf00 0xd370 0xd900 0xdb80
			>;
			/* Address 0x90h starts here */
			battery2,cell_character1 = <
				0x0170 0x11a0 0x1160 0x0ee0 0x13c0 0x16d0 0x17c0 0x10f0
				0x0820 0x08e0 0x07c0 0x07c0 0x0710 0x0720 0x07a0 0x07a0
			>;
			/* Address 0xA0h starts here */
			battery2,cell_character2 = <
				0x0200 0x0200 0x0200 0x0200 0x0200 0x0200 0x0200 0x0200
				0x0200 0x0200 0x0200 0x0200 0x0200 0x0200 0x0200 0x0200
			>;

		battery2,selected_reg = <
			0x02 0x7F80	/* default */
			0x12 0x2A00	/* QResidual00 */
			0x1E 0x0247	/* ICHGTerm */
			0x21 0x6200	/* default */
			0x22 0x1580	/* QResidual10 */
			0x2A 0x023C	/* RelaxCFG */
			0x2C 0xE3E1	/* TGAIN */
			0x2D 0x290E	/* TOFF */
			0x2E 0x0400	/* CGAIN */
			0x2F 0x0001	/* COFF */
			0x32 0x0B00	/* QResidual20 */
			0x33 0xFFFF	/* default */
			0x37 0x05E0	/* default */
			0x42 0x0900	/* QResidual30 */
			0xB4 0x7F80	/* default */
			0xB8 0x0000	/* default */
			0xB9 0x006B	/* default */
			0xBA 0x090C	/* default */
			>;

		/* 11 : SDI battery data */
		battery3,v_empty = <0xA561>; /* Empty: 3400mV, Recover: 4000mV */
		battery3,v_empty_origin = <0x7D54>; /* Empty: 2500mV, Recover: 3360mV */
		battery3,capacity = <0x0708>;
					/* fullcapnom dPacc dQacc RCOMP0 TempCo */
		battery3,fg_reset_wa_data = <0x0708 0x3200 0x01C2 0x002F 0x171F>;

		battery3,data_ver = <0x4>;

			battery3,atRate = <0x1900>; //2100mA
			battery3,config = <0x0210>; //0x0110 (FGCC disabled & Thermistor disable)
			battery3,config2 = <0x0050>; //TAlrtEn as 1 & OCVQen enable
			battery3,convgCfg = <0x2440>;
			battery3,fullcaprep = <0x0708>;
			battery3,fullsocthr = <0x5F00>; //95%
			battery3,iavg_empty = <0x05A0>;
			battery3,learnCFG = <0x2606>;
			battery3,misccfg = <0x3850>; //0x0870 (MixRate as 1.875000 mA)
			battery3,cv_mixCap = <0x1356>; //CV_MixCap (2475mA) is 75% of FullCapNom (0x17FA ; 3300mAh)
			battery3,cv_HalfTime = <0x0600>; //18 minutes --> 30*60/(0.1758125*4) = 1536 = 0x0600
			battery3,tempNom = <0x1403>;
			battery3,tempLim = <0x1E05>;

			/* Address 0x80h starts here */
			battery3,cell_character0 = <
				0xa780 0xb360 0xb890 0xbac0 0xbc90 0xbcf0 0xbd80 0xbe30
				0xbf80 0xc040 0xc240 0xc2b0 0xc9b0 0xce60 0xd500 0xdaf0
			>;
			/* Address 0x90h starts here */
			battery3,cell_character1 = <
				0x0100 0x0600 0x1100 0x0cf0 0x2a10 0x1a40 0x1700 0x0f00
				0x1ab0 0x0cf0 0x0c80 0x07d0 0x07f0 0x06d0 0x06f0 0x06f0
			>;
			/* Address 0xA0h starts here */
			battery3,cell_character2 = <
				0x0200 0x0200 0x0200 0x0200 0x0200 0x0200 0x0200 0x0200
				0x0200 0x0200 0x0200 0x0200 0x0200 0x0200 0x0200 0x0200
			>;

		battery3,selected_reg = <
			0x02 0x7F80	/* default */
			0x12 0x3C00	/* QResidual00 */
			0x1E 0x0247	/* ICHGTerm */
			0x21 0x6200	/* default */
			0x22 0x1E00	/* QResidual10 */
			0x2A 0x023C	/* RelaxCFG */
			0x2C 0xE3E1	/* TGAIN */
			0x2D 0x290E	/* TOFF */
			0x2E 0x0400	/* CGAIN */
			0x2F 0x0001	/* COFF */
			0x32 0x0F00	/* QResidual20 */
			0x33 0xFFFF	/* default */
			0x37 0x05E0	/* default */
			0x42 0x0D00	/* QResidual30 */
			0xB4 0x7F80	/* default */
			0xB8 0x0000	/* default */
			0xB9 0x006B	/* default */
			0xBA 0x090C	/* default */
			>;
	};
};
